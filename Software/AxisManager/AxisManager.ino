


/*-----------------------------------------------------------------------------------------------------
  | author: Gritti Francesco
  -----------------------------------------------------------------------------------------------------
  | date: 08/28/2020
  -----------------------------------------------------------------------------------------------------
  | description: This program takes care of the positioning of two axes of a 
  | moving system. The movement of the axes is acomplished by two brushed motor,
  | and the feedback is produced by two optycal encoder with quadrature output signals.
  |
  | The target position is set through the I2C bus. In order to set a position the master has
  | to send a "set target position" command (0x01) followed by two 16 bits integer values 
  | (X and Y) positions. When the axis is moving the interrupt pin state is LOW. When both
  | the axes reach the taret position, the interrupt pin is driven HIGH.
  |
  |  The reading of the encoders output signals is done by two interrupt routines. These interrupts
  |  Are thrown by the change of state of one of the two signals of the encoder.
  -----------------------------------------------------------------------------------------------------
  | target device: Arduino Pro Mini
  -----------------------------------------------------------------------------------------------------
  
  */


#include <Wire.h>

#include "EncoderHandler.h"
#include "AxisHandler.h"


// define hardware connections to peripherals

#define AXIS_Y_ENCODER_A     4
#define AXIS_Y_ENCODER_B     1
#define AXIS_Y_MOTOR_A      10
#define AXIS_Y_MOTOR_B      16
#define AXIS_Y_ZERO_SWITCH   7


#define AXIS_X_ENCODER_A    5
#define AXIS_X_ENCODER_B    0
#define AXIS_X_MOTOR_A      14
#define AXIS_X_MOTOR_B      15
#define AXIS_X_ZERO_SWITCH  6

#define INTERRUPT_PIN       9


// define I2C parameters

#define SET_TARGET_POSITION 0x01  // command use to set a target position
#define I2C_ADDRESS         0x30  // this module address


// create two object for handling one axis each

AxisHandler axisY(AXIS_Y_MOTOR_A, AXIS_Y_MOTOR_B, AXIS_Y_ENCODER_A, AXIS_Y_ENCODER_B, AXIS_Y_ZERO_SWITCH);
AxisHandler axisX(AXIS_X_MOTOR_A, AXIS_X_MOTOR_B, AXIS_X_ENCODER_A, AXIS_X_ENCODER_B, AXIS_X_ZERO_SWITCH);


// global variables used to print on serial the current encoders values only when one of them changes
int prevXPos, prevYPos;

void setup() {

  // initialize serial communication
  Serial.begin(115200);

  // initialize I2C peripheral
  Wire.begin(I2C_ADDRESS);
  
  // set the handler function for master write
  Wire.onReceive(receiveHandler);

  // init axes
  axisY.init();
  axisX.init();

  pinMode(INTERRUPT_PIN, OUTPUT);
  digitalWrite(INTERRUPT_PIN, LOW);

  // calibrate the axes
  Serial.print("Y axis calibration... ");
  axisY.calibrate();
  Serial.println("DONE");
  axisY.stop();

  Serial.print("X axis calibration... ");
  axisX.calibrate();
  Serial.println("DONE");
  digitalWrite(INTERRUPT_PIN, HIGH);
  axisX.stop();

  // set the functions handler for external interrupts generated by the encoders
  attachInterrupt(digitalPinToInterrupt(AXIS_X_ENCODER_B), encoderXB_Callback, CHANGE);
  attachInterrupt(digitalPinToInterrupt(AXIS_Y_ENCODER_B), encoderYB_Callback, CHANGE);
}

void loop() {

  // if one of the two encoders position changed, print it and store the new value
  if (axisX.encoderHandler.getPos() != prevXPos || axisY.encoderHandler.getPos() != prevYPos) {
    Serial.print(axisX.encoderHandler.getPos()); Serial.print("   "); Serial.println(axisY.encoderHandler.getPos());

    prevXPos = axisX.encoderHandler.getPos();
    prevYPos = axisY.encoderHandler.getPos();
  }

  // if the axes reached the target positions, set interrupt pin hight to notify the master
  if (axisX.reachedTarget() && axisY.reachedTarget())digitalWrite(INTERRUPT_PIN, HIGH);
  // otherwise set it to LOW
  else digitalWrite(INTERRUPT_PIN, LOW);

  delay(100);
}


void encoderYB_Callback() {

  axisY.encoderHandler.B_SignalCallbackHandler();
  axisY.run();
}

void encoderXB_Callback() {

  axisX.encoderHandler.B_SignalCallbackHandler();
  axisX.run();
}


// receiver handler. This function is called when the master writes data to this slave.
void receiveHandler(int n) {

  uint8_t data[n] {};  // cerate an array to store the received data

  for (uint8_t i = 0; i < n; i++) {
    data[i] = Wire.read();    // read data
  }
  if (data[0] == SET_TARGET_POSITION) {   // if the master sent a "set target position" command

    // read both target X position and target Y position
    int xPos = (data[1] << 8) | data[2];
    int yPos = (data[3] << 8) | data[4];

    // drive interrupt pin LOW
    digitalWrite(INTERRUPT_PIN, LOW);

    // set the new target positions
    axisX.setTarget(xPos);
    axisY.setTarget(yPos);
  }
}
